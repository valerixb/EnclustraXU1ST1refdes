## yocto/sources/meta-enclustra-refdes/conf/layer.conf
```bitbake
BBPATH .= ":${LAYERDIR}"

BBFILES += " \
${LAYERDIR}/recipes-*/*/*.bb \
${LAYERDIR}/recipes-*/*/*.bbappend \
"

BBFILE_COLLECTIONS += "enclustra-refdes"
BBFILE_PATTERN_enclustra-refdes = "^${LAYERDIR}/"
BBFILE_PRIORITY_enclustra-refdes = "20"
LAYERVERSION = "1"
LAYERSERIES_COMPAT_enclustra-refdes = "scarthgap"
```
