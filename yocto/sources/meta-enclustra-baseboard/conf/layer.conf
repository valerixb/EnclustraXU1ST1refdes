## yocto/sources/meta-enclustra-baseboard/conf/layer.conf
```bitbake
BBPATH .= ":${LAYERDIR}"

BBFILES += " \
${LAYERDIR}/recipes-*/*/*.bb \
${LAYERDIR}/recipes-*/*/*.bbappend \
"

BBFILE_COLLECTIONS += "enclustra-baseboard"
BBFILE_PATTERN_enclustra-baseboard = "^${LAYERDIR}/"
BBFILE_PRIORITY_enclustra-baseboard = "20"
LAYERVERSION = "1"
LAYERSERIES_COMPAT_enclustra-baseboard = "scarthgap"
```

## yocto/sources/meta-enclustra-module/conf/layer.conf
```bitbake
BBPATH .= ":${LAYERDIR}"

BBFILES += " \
${LAYERDIR}/recipes-*/*/*.bb \
${LAYERDIR}/recipes-*/*/*.bbappend \
"

YOCTOROOT = "${@os.path.abspath(os.path.join("${TOPDIR}", os.pardir))}"

BBFILES_DYNAMIC += " \
${@bb.utils.contains("BBLAYERS", "${YOCTOROOT}/meta-enclustra-refdes", "","xilinx:${LAYERDIR}/dynamic-layers/meta-enclustra-nopl/recipes-*/*/*.bb", d)} \
${@bb.utils.contains("BBLAYERS", "${YOCTOROOT}/meta-enclustra-refdes", "","xilinx:${LAYERDIR}/dynamic-layers/meta-enclustra-nopl/recipes-*/*/*.bbappend", d)} \
"

BBFILE_COLLECTIONS += "enclustra-module"
BBFILE_PATTERN_enclustra-module = "^${LAYERDIR}/"
BBFILE_PRIORITY_enclustra-module = "10"
BBFILE_PATTERN_IGNORE_EMPTY_enclustra-module = "1"

LAYERVERSION = "1"
LAYERSERIES_COMPAT_enclustra-module = "scarthgap"
LAYERDEPENDS_enclustra-module = "xilinx"
```

## yocto/sources/meta-enclustra-module/conf/machine/xru30-module.conf
```bitbake
## preamble
MACHINEOVERRIDES =. "${@['', 'xru30-module:']['xru30-module' != '${MACHINE}']}"

require conf/machine/zynqmp-override.inc
require conf/machine/qspi-64-mbytes.inc

## postamble
PACKAGE_EXTRA_ARCHS:append = "${@['', ' xru30_module']['xru30-module' != "${MACHINE}"]}"
```

## yocto/sources/meta-enclustra-module/conf/machine/xru50-module.conf
```bitbake
## preamble
MACHINEOVERRIDES =. "${@['', 'xru50-module:']['xru50-module' != '${MACHINE}']}"

require conf/machine/zynqmp-override.inc
require conf/machine/qspi-128-mbytes.inc

## postamble
PACKAGE_EXTRA_ARCHS:append = "${@['', ' xru50_module']['xru50-module' != "${MACHINE}"]}"
```

## yocto/sources/meta-enclustra-module/conf/machine/xu1-module.conf
```bitbake
## preamble
MACHINEOVERRIDES =. "${@['', 'xu1-module:']['xu1-module' != '${MACHINE}']}"

require conf/machine/zynqmp-override.inc
require conf/machine/qspi-64-mbytes.inc

## postabmle
PACKAGE_EXTRA_ARCHS:append = "${@['', ' xu1_module']['xu1-module' != "${MACHINE}"]}"
```

## yocto/sources/meta-enclustra-module/conf/machine/xu3-module.conf
```bitbake
## preamble
MACHINEOVERRIDES =. "${@['', 'xu3-module:']['xu3-module' != '${MACHINE}']}"

require conf/machine/zynqmp-override.inc
require conf/machine/qspi-64-mbytes.inc

## postabmle
PACKAGE_EXTRA_ARCHS:append = "${@['', ' xu3_module']['xu3-module' != "${MACHINE}"]}"
```

## yocto/sources/meta-enclustra-module/conf/machine/xu5-module.conf
```bitbake
## preamble
MACHINEOVERRIDES =. "${@['', 'xu5-module:']['xu5-module' != '${MACHINE}']}"

require conf/machine/zynqmp-override.inc
require conf/machine/qspi-64-mbytes.inc

## postabmle
PACKAGE_EXTRA_ARCHS:append = "${@['', ' xu5_module']['xu5-module' != "${MACHINE}"]}"
```

## yocto/sources/meta-enclustra-module/conf/machine/xu6-module.conf
```bitbake
## preamble
MACHINEOVERRIDES =. "${@['', 'xu6-module:']['xu6-module' != '${MACHINE}']}"

require conf/machine/zynqmp-override.inc
require conf/machine/qspi-64-mbytes.inc

## postabmle
PACKAGE_EXTRA_ARCHS:append = "${@['', ' xu6_module']['xu6-module' != "${MACHINE}"]}"
```

## yocto/sources/meta-enclustra-module/conf/machine/xu61-module.conf
```bitbake
## preamble
MACHINEOVERRIDES =. "${@['', 'xu61-module:']['xu61-module' != '${MACHINE}']}"

require conf/machine/zynqmp-override.inc
require conf/machine/qspi-64-mbytes.inc

## postabmle
PACKAGE_EXTRA_ARCHS:append = "${@['', ' xu61_module']['xu61-module' != "${MACHINE}"]}"
```

## yocto/sources/meta-enclustra-module/conf/machine/xu7-module.conf
```bitbake
## preamble
MACHINEOVERRIDES =. "${@['', 'xu7-module:']['xu7-module' != '${MACHINE}']}"

require conf/machine/zynqmp-override.inc
require conf/machine/qspi-64-mbytes.inc

## postabmle
PACKAGE_EXTRA_ARCHS:append = "${@['', ' xu7_module']['xu7-module' != "${MACHINE}"]}"
```

## yocto/sources/meta-enclustra-module/conf/machine/xu8-module.conf
```bitbake
## preamble
MACHINEOVERRIDES =. "${@['', 'xu8-module:']['xu8-module' != '${MACHINE}']}"

require conf/machine/zynqmp-override.inc
require conf/machine/qspi-64-mbytes.inc

## postabmle
PACKAGE_EXTRA_ARCHS:append = "${@['', ' xu8_module']['xu8-module' != "${MACHINE}"]}"
```

## yocto/sources/meta-enclustra-module/conf/machine/xu9-module.conf
```bitbake
## preamble
MACHINEOVERRIDES =. "${@['', 'xu9-module:']['xu9-module' != '${MACHINE}']}"

require conf/machine/zynqmp-override.inc
require conf/machine/qspi-64-mbytes.inc

## postabmle
PACKAGE_EXTRA_ARCHS:append = "${@['', ' xu9_module']['xu9-module' != "${MACHINE}"]}"
```

## yocto/sources/meta-enclustra-module/conf/machine/xzu65-module.conf
```bitbake
## preamble
MACHINEOVERRIDES =. "${@['', 'xzu65-module:']['xzu65-module' != '${MACHINE}']}"

require conf/machine/zynqmp-override.inc
require conf/machine/qspi-128-mbytes.inc

## postabmle
PACKAGE_EXTRA_ARCHS:append = "${@['', ' xzu65_module']['xzu65-module' != "${MACHINE}"]}"
```

## yocto/sources/meta-enclustra-module/conf/machine/xzu90-module.conf
```bitbake
## preamble
MACHINEOVERRIDES =. "${@['', 'xzu90-module:']['xzu90-module' != '${MACHINE}']}"

require conf/machine/zynqmp-override.inc
require conf/machine/qspi-128-mbytes.inc

## postabmle
PACKAGE_EXTRA_ARCHS:append = "${@['', ' xzu90_module']['xzu90-module' != "${MACHINE}"]}"
```

## yocto/sources/meta-enclustra-module/conf/machine/zx1-module.conf
```bitbake
MACHINEOVERRIDES =. "${@['', 'zx1-module:']['zx1-module' != '${MACHINE}']}"

require conf/machine/zynq-override.inc
require conf/machine/qspi-64-mbytes.inc

PACKAGE_EXTRA_ARCHS:append = "${@['', ' zx1_module']['zx1-module' != "${MACHINE}"]}"
```

## yocto/sources/meta-enclustra-module/conf/machine/zx2-module.conf
```bitbake
MACHINEOVERRIDES =. "${@['', 'zx2-module:']['zx2-module' != '${MACHINE}']}"

require conf/machine/zynq-override.inc
require conf/machine/qspi-64-mbytes.inc

PACKAGE_EXTRA_ARCHS:append = "${@['', ' zx2_module']['zx2-module' != "${MACHINE}"]}"
```

## yocto/sources/meta-enclustra-module/conf/machine/zx3-module.conf
```bitbake
MACHINEOVERRIDES =. "${@['', 'zx3-module:']['zx3-module' != '${MACHINE}']}"

require conf/machine/zynq-override.inc
require conf/machine/qspi-64-mbytes.inc

PACKAGE_EXTRA_ARCHS:append = "${@['', ' zx3_module']['zx3-module' != "${MACHINE}"]}"
```

## yocto/sources/meta-enclustra-module/conf/machine/zx5-module.conf
```bitbake
MACHINEOVERRIDES =. "${@['', 'zx5-module:']['zx5-module' != '${MACHINE}']}"

require conf/machine/zynq-override.inc
require conf/machine/qspi-64-mbytes.inc

PACKAGE_EXTRA_ARCHS:append = "${@['', ' zx5_module']['zx5-module' != "${MACHINE}"]}"
```
