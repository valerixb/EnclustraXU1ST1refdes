#include "include/dt-bindings/phy/phy.h"

/*
/ {
	aliases {
		mmc0 = &sdhci0;
		mmc1 = &sdhci1;
	};
};
*/

&dwc3_0 {
	dr_mode = "host";
	snps,usb3_lpm_capable;
	phy-names = "usb3-phy";
	phys = <&psgtr 2 PHY_TYPE_USB3 0 2>;
	maximum-speed = "super-speed";
};

&dwc3_1 {
	dr_mode = "host";
	snps,usb3_lpm_capable;
	phy-names = "usb3-phy";
	phys = <&psgtr 3 PHY_TYPE_USB3 1 2>;
	maximum-speed = "super-speed";
};

/* SD1 with level shifter */
&sdhci1 {
	no-1-8-v;	/* for 1.0 silicon */
	wp-inverted;
	xlnx,mio_bank = <1>;
};

/*
&amba {
	ref100: ref100M {
		compatible = "fixed-clock";
		#clock-cells = <0>;
		clock-frequency = <100000000>;
	};
};


&zynqmp_dp_snd_pcm0 {
	status = "disabled";
};

&zynqmp_dp_snd_pcm1 {
	status = "disabled";
};

&zynqmp_dp_snd_card0 {
	status = "disabled";
};

&zynqmp_dp_snd_codec0 {
	status = "disabled";
};
*/
